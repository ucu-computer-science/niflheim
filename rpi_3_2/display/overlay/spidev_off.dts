/dts-v1/;
/plugin/;

/ {
    compatible = "brcm,bcm2708";

    fragment@0 {
        target = <&spidev1>;

        __overlay__ {
            status = "disabled";
        };
    };
    fragment@1 {
        target = <&spidev0>;

        __overlay__ {
            status = "disabled";
        };
    };
};
